// SPDX-License-Identifier: GPL-2.0-or-later OR MIT

/dts-v1/;

#include "ipq6000-xiaomi.dtsi"

/ {
	model = "Redmi AX5";
	compatible = "redmi,ax5", "qcom,ipq6018";
};

&wifi {
	qcom,ath11k-calibration-variant = "Redmi-AX5";
};
